## Ghotoid2-akdk/Ghotoid2-akdk/boards/shields/ghotoid2/Kconfig.defconfig
```kconfig
if SHIELD_GHOTOID2_LEFT

config ZMK_KEYBOARD_NAME
    default "ghotoid2"

endif

if SHIELD_GHOTOID2_LEFT || SHIELD_GHOTOID2_RIGHT

config ZMK_SPLIT
    default y

endif
```

## boards/shields/ghotoid2/Kconfig.shield
```kconfig
config SHIELD_GHOTOID2_LEFT
    def_bool $(shields_list_contains,ghotoid2_left)
config SHIELD_GHOTOID2_RIGHT
    def_bool $(shields_list_contains,ghotoid2_right)
```

## config/west.yml
```yaml
manifest:
  remotes:
    - name: zmkfirmware
      url-base: https://github.com/zmkfirmware
    - name: sekigon-gonnoc
      url-base: https://github.com/sekigon-gonnoc
  projects:
    - name: zmk
      remote: zmkfirmware
      revision: v0.2
      import: app/west.yml
  self:
    path: config

    remotes:
    - name: caksoylar
      url-base: https://github.com/caksoylar
  projects:
    - name: zmk-battery-center
      remote: caksoylar
      revision: main
```
